## drivers/net/wireless/bl602_sdio_driver/BL602_HostDriver/Kconfig
```kconfig
menuconfig BL_FULLMAC
	tristate "BoufalloLab FullMAC WLAN support"
	default n
	select CFG80211
	help
	  To compile this code as a module, choose M here.
```
